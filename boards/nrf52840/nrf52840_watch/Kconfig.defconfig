## boards/nrf52840/nrf52840_watch/Kconfig.defconfig
```kconfig
if BOARD_NRF52840_WATCH

config BT_CTLR
	default BT

endif # BOARD_NRF52840_WATCH
```

## boards/nrf52840/nrf52840_watch/nrf52840_watch_defconfig
```kconfig
CONFIG_ARM_MPU=y
CONFIG_HW_STACK_PROTECTION=y
# enable GPIO
CONFIG_GPIO=y

CONFIG_CLOCK_CONTROL=y
CONFIG_NFCT_PINS_AS_GPIOS=y

# console
CONFIG_CONSOLE=y
CONFIG_SERIAL=n
CONFIG_UART_CONSOLE=n
```
